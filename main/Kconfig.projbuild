## main/Kconfig.projbuild
```kconfig
menu "PUF Generator"

    config PUF_ALLOW_FINGERPRINT_OUTPUT
        bool "Allow fingerprint output to UART"
        default y
        help
            Включает печать сырых байт отпечатка.
            По умолчанию ВКЛЮЧЕНО для dev/enroll-процесса.
            Для production отключи: прошивка будет печатать только маркер "PUF_OK".

    config PUF_FINGERPRINT_BITS
        int "Длина отпечатка в битах"
        default 256
        range 64 512
        help
            Длина генерируемого PUF-идентификатора.
            Ограничен размером SRAM-буфера в .noinit (kDefaultSramPufBytes * 8).

endmenu
```
